#pragma once
#include <Arduino.h>
#include <stdint.h>

#define RF_N_TREES 100
#define RF_N_FEATURES 11
#define RF_N_CLASSES 4
#define RF_TOTAL_NODES 766

static const char* const RF_FEATURE_NAMES[RF_N_FEATURES] = {
  "V1", "I1", "P1",
  "PF1", "V2", "I2",
  "P2", "PF2", "Power_Diff",
  "Current_Diff", "Voltage_Diff"
};

static const char* const RF_CLASS_NAMES[RF_N_CLASSES] = {
  "Direct Theft (Bypass)", "Idle / Both OFF",
  "Normal Operation (Consumer Only)", "Partial Theft (Both Loads Active)"
};

static const uint16_t RF_TREE_ROOTS[RF_N_TREES] = {
  0, 7, 14, 21, 28, 39, 46, 53, 64, 71,
  78, 85, 92, 105, 112, 119, 126, 133, 140, 151,
  164, 181, 188, 195, 202, 213, 220, 227, 234, 241,
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  692, 699, 706, 713, 720, 727, 738, 745, 752, 759
};

static const uint16_t RF_LEFT[RF_TOTAL_NODES] = {
  1, 65535, 3, 4, 65535, 65535, 65535, 8, 9, 65535,
  65535, 12, 65535, 65535, 15, 65535, 17, 65535, 19, 65535,
  65535, 22, 65535, 24, 65535, 26, 65535, 65535, 29, 30,
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  65535, 762, 65535, 764, 65535, 65535
};

static const uint16_t RF_RIGHT[RF_TOTAL_NODES] = {
  2, 65535, 6, 5, 65535, 65535, 65535, 11, 10, 65535,
  65535, 13, 65535, 65535, 16, 65535, 18, 65535, 20, 65535,
  65535, 23, 65535, 25, 65535, 27, 65535, 65535, 36, 33,
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  65535, 763, 65535, 765, 65535, 65535
};

static const int8_t RF_FEATURE[RF_TOTAL_NODES] = {
  9, -1, 5, 2, -1, -1, -1, 6, 8, -1, -1, 3,
  -1, -1, 9, -1, 2, -1, 7, -1, -1, 2, -1, 8,
  -1, 1, -1, -1, 7, 10, 8, -1, -1, 3, -1, -1,
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  1, -1, -1, 3, -1, 9, -1, 1, -1, -1
};

static const double RF_THRESHOLD[RF_TOTAL_NODES] = {
  0.05249999836087227, 0.0, 0.01549999974668026, 2.75,
  0.0, 0.0, 0.0, 3.5999999046325684,
  2.75, 0.0, 0.0, 0.4950000047683716,
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  0.0, 0.0
};

static const double RF_NODE_VALUES[RF_TOTAL_NODES][RF_N_CLASSES] = {

  {0.22272727272727272, 0.2818181818181818, 0.35, 0.14545454545454545},
  {0.0, 0.0, 1.0, 0.0},
  {0.34265734265734266, 0.43356643356643354, 0.0, 0.22377622377622378},
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  {0.0, 0.0, 0.0, 1.0}
};

static void rf_predict_proba(
    const double x[RF_N_FEATURES],
    double outProba[RF_N_CLASSES]
) {
    for (int c = 0; c < RF_N_CLASSES; ++c) {
        outProba[c] = 0.0;
    }

    for (int t = 0; t < RF_N_TREES; ++t) {
        uint16_t node = RF_TREE_ROOTS[t];

        while (RF_FEATURE[node] >= 0) {
            int f = RF_FEATURE[node];

            if (x[f] <= RF_THRESHOLD[node]) {
                node = RF_LEFT[node];
            } else {
                node = RF_RIGHT[node];
            }
        }

        double total = 0.0;
        for (int c = 0; c < RF_N_CLASSES; ++c) {
            total += RF_NODE_VALUES[node][c];
        }

        if (total > 0.0) {
            for (int c = 0; c < RF_N_CLASSES; ++c) {
                outProba[c] += RF_NODE_VALUES[node][c] / total;
            }
        }
    }

    for (int c = 0; c < RF_N_CLASSES; ++c) {
        outProba[c] /= RF_N_TREES;
    }
}

static uint8_t rf_predict(
    const double x[RF_N_FEATURES],
    double outProba[RF_N_CLASSES]
) {
    rf_predict_proba(x, outProba);

    uint8_t best = 0;
    for (uint8_t c = 1; c < RF_N_CLASSES; ++c) {
        if (outProba[c] > outProba[best]) {
            best = c;
        }
    }
    return best;
}
